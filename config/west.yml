## config/west.yml
```yaml
# See https://docs.zephyrproject.org/3.2.0/develop/west/manifest.html#projects
manifest:
  defaults:
    remote: urob
    revision: main

  remotes:
    - name: zmkfirmware
      url-base: https://github.com/zmkfirmware

    # nice-view-gem
    - name: m165437
      url-base: https://github.com/M165437

    # zmk-helpers, zmk-leader-key
    - name: urob
      url-base: https://github.com/urob

  projects:
    - name: zmk
      remote: zmkfirmware
      revision: main
      import: app/west.yml

    # nice-view-gem
    - name: nice-view-gem
      remote: m165437
      revision: main

    # urob zmk modules
    - name: zmk-helpers
      path: modules/zmk/helpers
    - name: zmk-leader-key
      path: modules/zmk/leader-key
    - name: zmk-adaptive-key
      path: modules/zmk/adaptive-key
    - name: zmk-auto-layer
      path: modules/zmk/auto-layer
    - name: zmk-tri-state
      path: modules/zmk/tri-state

  self:
    path: config
```
