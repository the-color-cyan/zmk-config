/*
 * Copyright (c) 2020 The ZMK Contributors
 *
 * SPDX-License-Identifier: MIT
 */

// TODO: add num_word from auto-layer module 

#include <behaviors.dtsi>
#include <dt-bindings/zmk/bt.h>
#include <dt-bindings/zmk/keys.h>

// bluetooth bindings 
#define _BT_SEL_KEYS_ \
    &bt BT_SEL 0 &bt BT_SEL 1 &bt BT_SEL 2 &bt BT_SEL 3 &bt BT_SEL 4 &bt BT_CLR

#include <zmk-helpers/helper.h>
#include <zmk-helpers/key-labels/42.h>

#define CLMK 0
#define QWTY 1
#define GAME 2
#define VGAME 3
#define NUMSYM 4
#define NAV 5
#define FN 6
#define SYS 7

#define XXX &none
#define ___ &trans

/* GLOBAL DEFAULTS */

#define QUICK_TAP_MS 175

// sticky keys 
&sk {
    release-after-ms = <900>;
    quick-release;
};

// sticky layers - allow sticky mods to chord across sticky layers 
&sl {
    ignore-modifiers;
};

// layer tap
&lt {
    flavor = "balanced";
    tapping-term-ms = <200>;
    quick-tap-ms = <QUICK_TAP_MS>;
};

/* HOMEROW MODS */

#define KEYS_L LT0 LT1 LT2 LT3 LT4 LT5 LM0 LM1 LM2 LM3 LM4 LM5 LB0 LB1 LB2 LB3 LB4 LB5
#define KEYS_R RT0 RT1 RT2 RT3 RT4 RT5 RM0 RM1 RM2 RM3 RM4 RM5 RB0 RB1 RB2 RB3 RB4 RB5
#define THUMBS LH2 LH1 LH0 RH0 RH1 RH2

#define MAKE_HRM(NAME, HOLD, TAP, TRIGGER_POS) \
    ZMK_HOLD_TAP(NAME, \
                 bindings = <HOLD>, <TAP>; \
                 flavor = "balanced"; \
                 tapping-term-ms = <280>; \
                 quick-tap-ms = <QUICK_TAP_MS>; \
                 require-prior-idle-ms = <150>; \
                 hold-trigger-on-release; \
                 hold-trigger-key-positions = <TRIGGER_POS>;)

MAKE_HRM(hml, &kp, &kp, KEYS_R THUMBS) // left hand hrms
MAKE_HRM(hmr, &kp, &kp, KEYS_L THUMBS) // right hand hrms

// HACK: make hrm combos tap only 
#define ZMK_COMBO_8(NAME, TAP, POS, LAYERS, COMBO_MS, IDLE_MS, HOLD, SIDE) \
    MAKE_HRM(hm_combo_##NAME, &kp, TAP, SIDE THUMBS) \
    ZMK_COMBO_6(NAME, &hm_combo_##NAME HOLD 0, POS, LAYERS, COMBO_MS, IDLE_MS)

#include "combos.dtsi" // must be sourced after HRM combo hack

/* NAV LAYER */

// trigger tap-action on all interrupts 
#define MT_CORE \
    flavor = "tap-preferred"; \
    tapping-term-ms = <220>; \
    quick-tap-ms = <220>; \
    hold-trigger-key-positions = <0>;

&mt { MT_CORE };

ZMK_HOLD_TAP(mt_home, bindings = <&masked_home>, <&kp>;
             MT_CORE)
ZMK_HOLD_TAP(mt_end, bindings = <&masked_end>, <&kp>;
             MT_CORE)

#define NAV_LEFT  &mt_home 0   LEFT  // tap: left  | long-tap: start of line.
#define NAV_RIGHT &mt_end 0    RIGHT // tap: right | long-tap: end   of line.
#define NAV_UP    &mt LG(UP)   UP    // tap: up    | long-tap: start of doc.
#define NAV_DOWN  &mt LG(DOWN) DOWN  // tap: down  | long-tap: end   of doc.
#define NAV_BSPC  &mt LA(BSPC) BSPC  // tap: bspc  | long-tap: delete word bwd.
#define NAV_DEL   &mt LA(DEL)  DEL   // tap: del   | long-tap: delete word fwd.

// mask CTRL on left/right hold so line navigation stays independent of CTRL.
#define MASK_MODS(NAME, MODS, BINDING) \
    ZMK_MOD_MORPH(NAME, bindings = <BINDING>, <BINDING>; \
                  mods = <MODS>;)

MASK_MODS(masked_home, (MOD_LCTL), &kp LG(LEFT))
MASK_MODS(masked_end, (MOD_LCTL), &kp LG(RIGHT))

/* MAGIC SHIFT */
// tap: repeat after alpha, else sticky-shift |
// shift + tap/ double-tap: caps-word | hold: shift.
#define MAGIC_SHIFT &magic_shift LSHFT 0
ZMK_HOLD_TAP(magic_shift, bindings = <&kp>, <&magic_shift_tap>;
             flavor = "balanced"; tapping-term-ms = <200>;
             quick-tap-ms = <QUICK_TAP_MS>;)
ZMK_MOD_MORPH(magic_shift_tap, bindings = <&shift_repeat>, <&caps_word>;
              mods = <(MOD_LSFT)>;)
ZMK_ADAPTIVE_KEY(
    shift_repeat, bindings = <&sk LSHFT>;
    repeat {
      trigger-keys = <A B C D E F G H I J K L M N O P Q R S T U V W X Y Z>;
      bindings = <&key_repeat>;
      max-prior-idle-ms = <1200>;
      strict-modifiers;
    };)
&caps_word { // mods deactivate caps-word, requires PR #1451.
  /delete-property/ ignore-modifiers;
};

/* CUSTOM KEYS */
// tap: backspace | lshft + tap: delete | rshft + tap: shift-delete.
ZMK_MOD_MORPH(bs_del, bindings = <&kp BSPC>, <&kp DEL>;
              mods = <(MOD_LSFT|MOD_RSFT)>; keep-mods = <MOD_RSFT>;)

/* KEYMAP */

#define ZMK_BASE_LAYER(name, LT, RT, LM, RM, LB, RB, LH, RH) \
    ZMK_LAYER(name, LT RT LM RM LB RB LH RH)

ZMK_BASE_LAYER(Clmk,
//╭─────────────┬─────────────┬─────────────┬─────────────┬─────────────┬─────────────╮ ╭──────────────┬─────────────┬─────────────┬─────────────┬─────────────┬─────────────╮
   &kp EQUAL     &kp Q         &kp W         &kp F         &kp P         &kp B        ,  &kp J          &kp L         &kp U         &kp Y         &kp SEMI      &bs_del      ,
//├─────────────┼─────────────┼─────────────┼─────────────┼─────────────┼─────────────┤ ├──────────────┼─────────────┼─────────────┼─────────────┼─────────────┼─────────────┤
   &kp TAB       &hml LALT A   &hml LSHFT R  &hml LGUI S   &hml LCTRL T  &kp G        ,  &kp M          &hmr LCTRL N  &hmr LGUI E   &hmr RSHFT I  &hmr LALT O   &kp SQT      ,
//├─────────────┼─────────────┼─────────────┼─────────────┼─────────────┼─────────────┤ ├──────────────┼─────────────┼─────────────┼─────────────┼─────────────┼─────────────┤
   &kp MINUS     &kp Z         &kp X         &kp C         &kp D         &kp V        ,  &kp K          &kp H         &kp COMMA     &kp DOT       &kp FSLH      &kp ESC      ,
//╰─────────────┴─────────────┴─────────────┼─────────────┼─────────────┼─────────────┤ ├──────────────┼─────────────┼─────────────┼─────────────┴─────────────┴─────────────╯
                                             &lt SYS ESC   MAGIC_SHIFT   &lt NAV SPACE,  &lt NUMSYM RET MAGIC_SHIFT   &lt FN ESC
//                                          ╰─────────────┴─────────────┴─────────────╯ ╰──────────────┴─────────────┴─────────────╯
)

ZMK_BASE_LAYER(Qwty,
//╭─────────────┬─────────────┬─────────────┬─────────────┬─────────────┬─────────────╮ ╭──────────────┬─────────────┬─────────────┬─────────────┬───────────────┬─────────────╮
   &kp EQUAL     &kp Q         &kp W         &kp E         &kp R         &kp T        ,  &kp Y          &kp U         &kp I         &kp O         &kp P           &bs_del      ,
//├─────────────┼─────────────┼─────────────┼─────────────┼─────────────┼─────────────┤ ├──────────────┼─────────────┼─────────────┼─────────────┼───────────────┼─────────────┤
   &kp TAB       &hml LALT A   &hml LSHFT S  &hml LGUI D   &hml LCTRL F  &kp G        ,  &kp H          &hmr LCTRL J  &hmr LGUI K   &hmr RSHFT L  &hmr LALT SEMI  &kp SQT      ,
//├─────────────┼─────────────┼─────────────┼─────────────┼─────────────┼─────────────┤ ├──────────────┼─────────────┼─────────────┼─────────────┼───────────────┼─────────────┤
   &kp MINUS     &kp Z         &kp X         &kp C         &kp V         &kp B        ,  &kp N          &kp M         &kp COMMA     &kp DOT       &kp FSLH        &kp ESC      ,
//╰─────────────┴─────────────┴─────────────┼─────────────┼─────────────┼─────────────┤ ├──────────────┼─────────────┼─────────────┼─────────────┴───────────────┴─────────────╯
                                             &lt SYS ESC   MAGIC_SHIFT   &lt NAV SPACE,  &lt NUMSYM RET MAGIC_SHIFT   &lt FN ESC
//                                          ╰─────────────┴─────────────┴─────────────╯ ╰──────────────┴─────────────┴─────────────╯
)

ZMK_BASE_LAYER(Game,
//╭─────────────┬─────────────┬─────────────┬─────────────┬─────────────┬─────────────╮ ╭──────────────┬─────────────┬─────────────┬─────────────┬──────────────┬─────────────╮
   &kp TAB       &kp Q         &kp W         &kp E         &kp R         &kp T        ,  &kp Y          &kp U         &kp I         &kp O         &kp P          &kp BSPC     ,
//├─────────────┼─────────────┼─────────────┼─────────────┼─────────────┼─────────────┤ ├──────────────┼─────────────┼─────────────┼─────────────┼──────────────┼─────────────┤
   &kp LSHFT     &kp A         &kp S         &kp D         &kp F         &kp G        ,  &kp H          &kp J         &kp K         &kp L         &kp SEMI       &kp SQT      ,
//├─────────────┼─────────────┼─────────────┼─────────────┼─────────────┼─────────────┤ ├──────────────┼─────────────┼─────────────┼─────────────┼──────────────┼─────────────┤
   &kp LCTRL     &kp Z         &kp X         &kp C         &kp V         &kp B        ,  &kp N          &kp M         &kp COMMA     &kp DOT       &kp FSLH       &kp ESC      ,
//╰─────────────┴─────────────┴─────────────┼─────────────┼─────────────┼─────────────┤ ├──────────────┼─────────────┼─────────────┼─────────────┴──────────────┴─────────────╯
                                             &mo SYS       &kp LALT      &kp SPACE    ,  &kp RET        &kp LGUI      &mo FN
//                                          ╰─────────────┴─────────────┴─────────────╯ ╰──────────────┴─────────────┴─────────────╯
)

ZMK_BASE_LAYER(VertGame,
//╭─────────────┬─────────────┬─────────────┬─────────────┬─────────────┬─────────────╮ ╭─────────────┬─────────────┬─────────────┬─────────────┬─────────────┬─────────────╮
   &kp LEFT      &kp ESC            XXX           XXX           XXX           XXX     ,       XXX           XXX           XXX           XXX      &kp D         &kp C        ,
//├─────────────┼─────────────┼─────────────┼─────────────┼─────────────┼─────────────┤ ├─────────────┼─────────────┼─────────────┼─────────────┼─────────────┼─────────────┤
   &kp DOWN      &kp UP             XXX           XXX           XXX           XXX     ,       XXX           XXX           XXX           XXX      &kp S         &kp X        ,
//├─────────────┼─────────────┼─────────────┼─────────────┼─────────────┼─────────────┤ ├─────────────┼─────────────┼─────────────┼─────────────┼─────────────┼─────────────┤
   &kp RIGHT     &kp TAB            XXX           XXX           XXX           XXX     ,       XXX           XXX           XXX           XXX      &kp A         &kp Z        ,
//╰─────────────┴─────────────┴─────────────┼─────────────┼─────────────┼─────────────┤ ├─────────────┼─────────────┼─────────────┼─────────────┴─────────────┴─────────────╯
                                             &mo SYS       &kp LALT      &kp SPACE    ,  &kp RET       &kp LGUI      &mo FN
//                                          ╰─────────────┴─────────────┴─────────────╯ ╰─────────────┴─────────────┴─────────────╯
)

// TODO: fix delayed HRM chording across layers
ZMK_BASE_LAYER(Numsym,
//╭─────────────┬─────────────┬─────────────┬─────────────┬─────────────┬─────────────╮ ╭─────────────┬───────────────┬───────────────┬────────────────┬───────────────┬─────────────╮
        ___           ___      &kp N7        &kp N8        &kp N9        &kp STAR     ,  &kp EXCL      &kp LBKT        &kp RBKT        &kp DLLR         &kp PIPE             ___     ,
//├─────────────┼─────────────┼─────────────┼─────────────┼─────────────┼─────────────┤ ├─────────────┼───────────────┼───────────────┼────────────────┼───────────────┼─────────────┤
        ___      &sk LALT      &hml LSHFT N4 &hml LGUI N5  &hml LCTRL N6 &kp FSLH     ,  &kp AT        &hml LCTRL LPAR &hml LGUI RPAR  &hml RSHFT PRCNT &hml LALT AMPS  &kp GRAVE    ,
//├─────────────┼─────────────┼─────────────┼─────────────┼─────────────┼─────────────┤ ├─────────────┼───────────────┼───────────────┼────────────────┼───────────────┼─────────────┤
        ___           ___      &kp N1        &kp N2        &kp N3        &kp DOT      ,  &kp HASH      &kp LBRC        &kp RBRC        &kp CARET        &kp BSLH             ___     ,
//╰─────────────┴─────────────┴─────────────┼─────────────┼─────────────┼─────────────┤ ├─────────────┼───────────────┼───────────────┼────────────────┴───────────────┴─────────────╯
                                                  ___      &kp N0             ___     ,       ___           ___           ___
//                                          ╰─────────────┴─────────────┴─────────────╯ ╰─────────────┴───────────────┴───────────────╯
)

// TODO: NAV_DOWN + NAV_UP -> ESC
ZMK_BASE_LAYER(Nav,
//╭─────────────┬─────────────┬─────────────┬─────────────┬─────────────┬─────────────╮ ╭─────────────┬─────────────┬─────────────┬─────────────┬─────────────┬─────────────╮
        ___           ___           ___           ___           ___           ___     ,  &kp TAB       &kp PG_UP     NAV_DEL       NAV_BSPC           ___           ___     ,
//├─────────────┼─────────────┼─────────────┼─────────────┼─────────────┼─────────────┤ ├─────────────┼─────────────┼─────────────┼─────────────┼─────────────┼─────────────┤
        ___      &sk LALT      &sk LSHFT     &sk LGUI      &sk LCTRL          ___     ,  NAV_LEFT      NAV_DOWN      NAV_UP        NAV_RIGHT     &kp RET            ___     ,
//├─────────────┼─────────────┼─────────────┼─────────────┼─────────────┼─────────────┤ ├─────────────┼─────────────┼─────────────┼─────────────┼─────────────┼─────────────┤
        ___           ___           ___           ___           ___           ___     ,  &kp INS       &kp PG_DN          ___           ___           ___           ___     ,
//╰─────────────┴─────────────┴─────────────┼─────────────┼─────────────┼─────────────┤ ├─────────────┼─────────────┼─────────────┼─────────────┴─────────────┴─────────────╯
                                                  ___           ___           ___     ,       ___           ___           ___
//                                          ╰─────────────┴─────────────┴─────────────╯ ╰─────────────┴─────────────┴─────────────╯
)

ZMK_BASE_LAYER(Fn,
//╭─────────────┬───────────────┬─────────────┬─────────────┬─────────────┬─────────────╮ ╭─────────────┬─────────────┬─────────────┬─────────────┬─────────────┬─────────────╮
        ___      &kp PSCRN       &kp F7        &kp F8        &kp F9        &kp F10      ,  &kp C_BRI_UP  &kp C_PREV    &kp C_PP      &kp C_NEXT         ___           ___     ,
//├─────────────┼───────────────┼─────────────┼─────────────┼─────────────┼─────────────┤ ├─────────────┼─────────────┼─────────────┼─────────────┼─────────────┼─────────────┤
        ___      &kp SLCK        &kp F4        &kp F5        &kp F6        &kp F11      ,       ___      &sk LCTRL     &sk LGUI      &sk RSHFT     &sk LALT           ___     ,
//├─────────────┼───────────────┼─────────────┼─────────────┼─────────────┼─────────────┤ ├─────────────┼─────────────┼─────────────┼─────────────┼─────────────┼─────────────┤
        ___      &kp PAUSE_BREAK &kp F1        &kp F2        &kp F3        &kp F12      ,  &kp C_BRI_DN  &kp C_VOL_DN  &kp C_MUTE    &kp C_VOL_UP       ___           ___     ,
//╰─────────────┴───────────────┴─────────────┼─────────────┼─────────────┼─────────────┤ ├─────────────┼─────────────┼─────────────┼─────────────┴─────────────┴─────────────╯
                                                    ___           ___           ___     ,       ___           ___           ___
//                                            ╰─────────────┴─────────────┴─────────────╯ ╰─────────────┴─────────────┴─────────────╯
)

ZMK_BASE_LAYER(Sys,
//╭─────────────┬─────────────┬─────────────┬─────────────┬─────────────┬─────────────╮ ╭─────────────┬─────────────┬─────────────┬─────────────┬─────────────┬─────────────╮
   &to QWTY           ___           ___           ___           ___           ___     ,                                     _BT_SEL_KEYS_                                   ,
//├─────────────┼─────────────┼─────────────┼─────────────┼─────────────┼─────────────┤ ├─────────────┼─────────────┼─────────────┼─────────────┼─────────────┼─────────────┤
   &to CLMK      &to VGAME       ___           ___           ___           ___     ,       ___           ___           ___           ___           ___           ___     ,
//├─────────────┼─────────────┼─────────────┼─────────────┼─────────────┼─────────────┤ ├─────────────┼─────────────┼─────────────┼─────────────┼─────────────┼─────────────┤
   &to GAME           ___           ___           ___           ___           ___     ,       ___           ___           ___           ___           ___           ___     ,
//╰─────────────┴─────────────┴─────────────┼─────────────┼─────────────┼─────────────┤ ├─────────────┼─────────────┼─────────────┼─────────────┴─────────────┴─────────────╯
                                                  ___           ___           ___     ,       ___           ___           ___
//                                          ╰─────────────┴─────────────┴─────────────╯ ╰─────────────┴─────────────┴─────────────╯
)

/* template layer keymap

//╭─────────────┬─────────────┬─────────────┬─────────────┬─────────────┬─────────────╮ ╭─────────────┬─────────────┬─────────────┬─────────────┬─────────────┬─────────────╮
        ___           ___           ___           ___           ___           ___     ,       ___           ___           ___           ___           ___           ___     ,
//├─────────────┼─────────────┼─────────────┼─────────────┼─────────────┼─────────────┤ ├─────────────┼─────────────┼─────────────┼─────────────┼─────────────┼─────────────┤
        ___           ___           ___           ___           ___           ___     ,       ___           ___           ___           ___           ___           ___     ,
//├─────────────┼─────────────┼─────────────┼─────────────┼─────────────┼─────────────┤ ├─────────────┼─────────────┼─────────────┼─────────────┼─────────────┼─────────────┤
        ___           ___           ___           ___           ___           ___     ,       ___           ___           ___           ___           ___           ___     ,
//╰─────────────┴─────────────┴─────────────┼─────────────┼─────────────┼─────────────┤ ├─────────────┼─────────────┼─────────────┼─────────────┴─────────────┴─────────────╯
                                                  ___           ___           ___     ,       ___           ___           ___
//                                          ╰─────────────┴─────────────┴─────────────╯ ╰─────────────┴─────────────┴─────────────╯

*/

/* vim: set ft=c: */
